## main/Kconfig.projbuild
```kconfig
menu "WireGuard Configuration"

    config WIREGUARD_ENABLE
        bool "Enable WireGuard"
        default n
        help
            Enable WireGuard VPN client.

    config WIREGUARD_PRIVATE_KEY
        string "WireGuard Private Key (base64)"
        default "cH7dEGJvUyd3yF8zAQFv7yHn5gmjuLFOY5ZXWxA1EHg="
        depends on WIREGUARD_ENABLE
        help
            Private key for the WireGuard interface (base64 encoded).

    config WIREGUARD_PEER_PUBLIC_KEY
        string "WireGuard Peer Public Key (base64)"
        default "bbTndSaSIX/N+hlxJIR+52sP2xM+lhqtBm3OB9vnBU4="
        depends on WIREGUARD_ENABLE
        help
            Public key of the WireGuard peer (server).

    config WIREGUARD_ENDPOINT
        string "WireGuard Server Endpoint"
        default "138.68.97.227"
        depends on WIREGUARD_ENABLE
        help
            Domain name or IP address of the WireGuard server.

    config WIREGUARD_PORT
        int "WireGuard Server Port"
        default 51820
        depends on WIREGUARD_ENABLE
        help
            Port number of the WireGuard server.

    config WIREGUARD_LOCAL_IP
        string "WireGuard Local IP Address"
        default "10.8.161.1"
        depends on WIREGUARD_ENABLE
        help
            IP address assigned to this client on the VPN .

endmenu
```
